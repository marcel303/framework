#define KLODDER_UPLOAD_DESCRIPTION "Created using 'Klodder', available for the iPhone and iPod Touch. [test] visit us at grannies-games.com"

String(PictureDeleteTitle, "Delete")
String(PictureDeleteText, "Delete this picture?")
String(PictureOverwriteTitle, "Overwrite")
String(PictureOverwriteText, "The LITE version of Klodder is limited to one picture only. Your current picture will be overwritten.")

// Save to album
String(AlbumSavedTitle, "Image saved")
String(AlbumSavedText, "The image has been saved to your photo album.")

// Email
String(EmailMessageSubject, "Klodder Picture")
String(EmailMessageBody, "Hello there. I created this picture using 'Klodder', available for the iPhone and iPod Touch!")
String(EmailAttachmentName, "Klodder Picture.png")
String(EmailUnavailableTitle, "Not supported")
String(EmailUnavailableText, "No e-mail account configured.")
String(EmailSentTitle, "E-mail sent")
String(EmailSentText, "Your e-mail has been sent or placed in the outbox.")
String(EmailFailedTitle, "E-mail failed")
String(EmailFailedText, "The device is unable to send your e-mail message.")

// Facebook support
String(FacebookKey, "e345ebaabd2acffd333062ef8fd64b72")
String(FacebookSecret, "0e878afefed9dab1e1cf935093175acb")
String(FacebookUploadPromptTitle, "Upload")
String(FacebookUploadPromptText, "You are about to upload a picture to Facebook.")
String(FacebookUploadSuccessTitle, "Success")
String(FacebookUploadSuccessText, "Your photo has been uploaded!")
String(FacebookUploadDescription, KLODDER_UPLOAD_DESCRIPTION)

// Flickr support
String(FlickrKey, "ad7facbc65f2b91d306876532278c964")
String(FlickrSecret, "aaf7adb9712e40e6")
String(FlickrUploadPromptTitle, "Upload")
String(FlickrUploadPromptText, "You are about to upload a picture to Flickr.")
String(FlickrUploadFilename, "Klodder Picture")
String(FlickrUploadDescription, KLODDER_UPLOAD_DESCRIPTION)
String(FlickrLoginPromptTitle, "Login")
String(FlickrLoginPromptText, "You will need to connect to your Flickr account before you proceed.")

// Replay
String(ReplayFailedTitle, "Replay failed")
String(ReplayFailedText, "The replay has failed. Possibly due to a programming error or backward compatibility issue.")

